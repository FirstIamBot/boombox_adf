## components/drv/Kconfig
```kconfig
menu "LVGL ESP Drivers"

    rsource "tft/Kconfig"

    rsource "touch/Kconfig"

endmenu
```

## components/encoder/Kconfig
```kconfig
menu "Rotary encoders"

	config RE_MAX
		int "Maximum number of rotary encoders"
		default 1
			
	config RE_INTERVAL_US
		int "Polling interval, us"
		default 10000 if IDF_TARGET_ESP8266
		default 1000 if !IDF_TARGET_ESP8266
		
	config RE_BTN_DEAD_TIME_US
		int "Button dead time, us"
		default 10000
			
	choice RE_BTN_PRESSED_LEVEL
		prompt "Logical level on pressed button"
		config RE_BTN_PRESSED_LEVEL_0
			bool "0"
		config RE_BTN_PRESSED_LEVEL_1
			bool "1"
	endchoice
	
	config RE_BTN_LONG_PRESS_TIME_US
		int "Long press timeout, us"
		default 500000

	config RE_ACCELERATION_MIN_CUTOFF
		int "Minimum Acceleration cutoff time (ms)"
		default 200
		help
            At this time in milliseconds between rotary ticks we want to be at the minimum acceleration

	config RE_ACCELERATION_MAX_CUTOFF
		int "Maximum Acceleration cutoff time (ms)"
		default 4
		help
            At this time in milliseconds between rotary ticks we want to be at the maximum acceleration
    
	config RE_A_GPIO
        int "Encoder A pin GPIO Num"
        default 16 if IDF_TARGET_ESP32C3
        default 16 if IDF_TARGET_ESP32 || IDF_TARGET_ESP32S2 || IDF_TARGET_ESP32S3
        help
            GPIO number for pin A encoder.
	config RE_B_GPIO
        int "Encoder B pin GPIO Num"
        default 17 if IDF_TARGET_ESP32C3
        default 17 if IDF_TARGET_ESP32 || IDF_TARGET_ESP32S2 || IDF_TARGET_ESP32S3
        help
            GPIO number for pin B encoder.
	config RE_BTN_GPIO
        int "Encoder Button(switch) pin GPIO Num"
        default 9 if IDF_TARGET_ESP32C3
        default 9 if IDF_TARGET_ESP32 || IDF_TARGET_ESP32S2 || IDF_TARGET_ESP32S3
        help
            GPIO number for pin Button(switch) GPIO encoder.
endmenu
```

## components/gui/Kconfig
```kconfig
menu "LVGL ESP Calibration"

    rsource "gui_touch_calibration/Kconfig"

endmenu
```

## sdkconfig.defaults.esp32
```kconfig
CONFIG_IDF_CMAKE=y
CONFIG_IDF_TARGET_ARCH_XTENSA=y
CONFIG_IDF_TARGET="esp32"
CONFIG_IDF_TARGET_ESP32=y
CONFIG_IDF_FIRMWARE_CHIP_ID=0x0000

#
# Audio HAL
#
CONFIG_ESP_LYRAT_V4_3_BOARD=y

#
# WiFi Memory Optimization for APSTA mode
# Reduces memory usage by ~50-70KB to prevent allocation failures
#
CONFIG_ESP_WIFI_DYNAMIC_RX_BUFFER_NUM=16
CONFIG_ESP_WIFI_DYNAMIC_TX_BUFFER_NUM=16
CONFIG_ESP_WIFI_MGMT_SBUF_NUM=12
```
